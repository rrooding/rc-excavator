## sdkconfig.defaults
```kconfig
# Default settings for the RC excavator firmware

CONFIG_IDF_TARGET="esp32"
CONFIG_IDF_TARGET_ESP32=y

#
# BT Configuration
CONFIG_BT_ENABLED=y
CONFIG_BTDM_CTRL_MODE_BR_EDR_ONLY=y
CONFIG_BT_BLUEDROID_ENABLED=y
CONFIG_BT_BLUEDROID_PINNED_TO_CORE_0=y
CONFIG_BT_BLUEDROID_PINNED_TO_CORE=0
CONFIG_BT_CLASSIC_ENABLED=y
CONFIG_BT_SPP_ENABLED=y
CONFIG_BT_SSP_ENABLED=y

#
# PS3
#
CONFIG_IDF_COMPATIBILITY_MASTER=y
CONFIG_IDF_COMPATIBILITY=4
```
